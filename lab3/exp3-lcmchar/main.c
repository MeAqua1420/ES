#include "stm32f10x.h"
#include "stm32f10x_tim.h"
#include "azk16.h"

const uint32_t fonts[]={0x00c0003f,0x00f90006,0x00a4005b,0x00b0004f,
												0x00990066,0x0092006d,0x0082007d,0x00d80027,
												0x0080007f,0x0090006f,0x00880077,0x0083007c,
												0x00c60039,0x00a1005e,0x00860079,0x008e0071};

volatile uint32_t disp[]={0x00ff0000,0x00890076,0x00cf0030,0x00ff0000};
volatile uint8_t dly=0;

const unsigned char bmp[]=
{
0x00,0x00,0x10,0xF8,0x00,0x00,0x00,0x30,0x08,0x88,0x48,0x30,0x00,0xB0,0x48,0x48, 
0x48,0xB0,0x00,0xE0,0x90,0x48,0x48,0x90,0x00,0x80,0x40,0x30,0xF8,0x00,0x00,0x00, 
0xE0,0x20,0x20,0x20,0x3E,0x24,0x24,0x24,0xE4,0x04,0x00,0xFC,0x04,0x64,0x9C,0x00, 
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0xFF,0xFF,0xFF,0xFF,0xFF,0xFF,0xFF,0xFF,0xFF,0xFF,0xFF,0xFF,0xFF,0xFF,0xFF,0xFF, 
};

USART_InitTypeDef USART_InitStructure;

void clock_init()
{
  /* GPIOA and GPIOB and TIM2 clock enable */
  RCC_APB1PeriphClockCmd(RCC_APB1Periph_TIM2 | RCC_APB1Periph_USART2,	ENABLE);
  RCC_APB2PeriphClockCmd(RCC_APB2Periph_GPIOA | RCC_APB2Periph_GPIOB | RCC_APB2Periph_GPIOC |
                         RCC_APB2Periph_AFIO | RCC_APB2Periph_TIM1 |
												 RCC_APB2Periph_USART1 | RCC_APB2Periph_SPI1,	ENABLE);
}

void pin_remap_init()
{
	GPIO_PinRemapConfig(GPIO_Remap_SWJ_JTAGDisable,ENABLE);
	GPIO_PinRemapConfig(GPIO_FullRemap_TIM2,ENABLE);	
}

void gpio_init()
{
  GPIO_InitTypeDef GPIO_InitStructure;

  GPIO_InitStructure.GPIO_Pin = GPIO_Pin_8 | GPIO_Pin_15;	// PA15 - TIM
  GPIO_InitStructure.GPIO_Mode = GPIO_Mode_AF_PP;
  GPIO_InitStructure.GPIO_Speed = GPIO_Speed_50MHz;
  GPIO_Init(GPIOA, &GPIO_InitStructure);

  GPIO_InitStructure.GPIO_Pin = GPIO_Pin_10 | GPIO_Pin_11;	// PB10,PB11 - TIM
  GPIO_Init(GPIOB, &GPIO_InitStructure);
	
  GPIO_InitStructure.GPIO_Pin = GPIO_Pin_2 | GPIO_Pin_9;	// PA2,PA9 - USART2,USART1
  GPIO_Init(GPIOA, &GPIO_InitStructure);
	
  GPIO_InitStructure.GPIO_Pin = GPIO_Pin_5 | GPIO_Pin_7;	// PA5,PA7 - SPI1
  GPIO_Init(GPIOA, &GPIO_InitStructure);

  GPIO_InitStructure.GPIO_Pin = GPIO_Pin_3 | GPIO_Pin_10 | GPIO_Pin_6;	// PA3,PA10 - USART2,USART1    PA6 - SPI1
  GPIO_InitStructure.GPIO_Mode = GPIO_Mode_IN_FLOATING;
  GPIO_Init(GPIOA, &GPIO_InitStructure);
	
  GPIO_InitStructure.GPIO_Pin = 0xf0ff;	// PB0-7,PB12-15 - LED_7SEG
  GPIO_InitStructure.GPIO_Mode = GPIO_Mode_Out_PP;
  GPIO_Init(GPIOB, &GPIO_InitStructure);
	
	PWR_BackupAccessCmd(ENABLE);//允许修改RTC 和后备寄存器
	RCC_LSEConfig(RCC_LSE_OFF);//关闭外部低速外部时钟信号功能后，PC13 PC14 PC15 才可以当普通IO用。

  GPIO_InitStructure.GPIO_Pin = GPIO_Pin_15;	// PC15 - LCM_CE
  GPIO_Init(GPIOC, &GPIO_InitStructure);
}

void timer_init()
{
	TIM_TimeBaseInitTypeDef  TIM_TimeBaseStructure;
	TIM_OCInitTypeDef  TIM_OCInitStructure;
	
	uint16_t CCR1_Val = 0;
	uint16_t CCR3_Val = 0;
	uint16_t CCR4_Val = 0;
	uint16_t PrescalerValue = 0;
	
	/* Compute the prescaler value */
  PrescalerValue = (uint16_t) (SystemCoreClock / 24000000) - 1;
  /* Time base configuration */
  TIM_TimeBaseStructure.TIM_Period = 59999;	// 计数周期=1000
  TIM_TimeBaseStructure.TIM_Prescaler = PrescalerValue;
  TIM_TimeBaseStructure.TIM_ClockDivision = 0;
  TIM_TimeBaseStructure.TIM_CounterMode = TIM_CounterMode_Up;

  TIM_TimeBaseInit(TIM2, &TIM_TimeBaseStructure);

  /* PWM1 Mode configuration: Channel1 */
  TIM_OCInitStructure.TIM_OCMode = TIM_OCMode_PWM1;
  TIM_OCInitStructure.TIM_OutputState = TIM_OutputState_Enable;
  TIM_OCInitStructure.TIM_Pulse = CCR1_Val;
  TIM_OCInitStructure.TIM_OCPolarity = TIM_OCPolarity_High;

  TIM_OC1Init(TIM2, &TIM_OCInitStructure);

  TIM_OC1PreloadConfig(TIM2, TIM_OCPreload_Enable);

  /* PWM1 Mode configuration: Channel3 */
  TIM_OCInitStructure.TIM_OutputState = TIM_OutputState_Enable;
  TIM_OCInitStructure.TIM_Pulse = CCR3_Val;

  TIM_OC3Init(TIM2, &TIM_OCInitStructure);

  TIM_OC3PreloadConfig(TIM2, TIM_OCPreload_Enable);

  /* PWM1 Mode configuration: Channel4 */
  TIM_OCInitStructure.TIM_OutputState = TIM_OutputState_Enable;
  TIM_OCInitStructure.TIM_Pulse = CCR4_Val;

  TIM_OC4Init(TIM2, &TIM_OCInitStructure);

  TIM_OC4PreloadConfig(TIM2, TIM_OCPreload_Enable);

  TIM_ARRPreloadConfig(TIM2, ENABLE);

  /* TIM2 enable counter */
  TIM_Cmd(TIM2, ENABLE);
}

void audio_init()
{
	TIM_TimeBaseInitTypeDef  TIM_TimeBaseStructure;
	TIM_OCInitTypeDef  TIM_OCInitStructure;
	
	uint16_t CCR1_Val = 1;
	uint16_t PrescalerValue = 0;
	
	/* Compute the prescaler value */
  //PrescalerValue = (uint16_t) (SystemCoreClock / 24000000) - 1;
	PrescalerValue = 0;
	
  /* Time base configuration */	// 计数时钟=24MHz/2=12MHz
  TIM_TimeBaseStructure.TIM_Period = 255;	// 播放8bit波形数据
  TIM_TimeBaseStructure.TIM_Prescaler = PrescalerValue;
  TIM_TimeBaseStructure.TIM_ClockDivision = TIM_CKD_DIV1;
  TIM_TimeBaseStructure.TIM_CounterMode = TIM_CounterMode_Up;
	TIM_TimeBaseStructure.TIM_RepetitionCounter = 0;

  TIM_TimeBaseInit(TIM1, &TIM_TimeBaseStructure);

  /* PWM1 Mode configuration: Channel1 */
  TIM_OCInitStructure.TIM_OCMode = TIM_OCMode_PWM1;
  TIM_OCInitStructure.TIM_OutputState = TIM_OutputState_Enable;
  TIM_OCInitStructure.TIM_Pulse = CCR1_Val;
  TIM_OCInitStructure.TIM_OCPolarity = TIM_OCPolarity_High;

  TIM_OC1Init(TIM1, &TIM_OCInitStructure);

  TIM_OC1PreloadConfig(TIM1, TIM_OCPreload_Enable);
	
  TIM_ARRPreloadConfig(TIM1, ENABLE);

	TIM_CCPreloadControl(TIM1, DISABLE);	// 关闭捕获比较通道预加载（为互补PWM输出同步更新正负通道准备的，而我们并非互补PWM输出，所以禁止）
	
	TIM_CtrlPWMOutputs(TIM1,ENABLE);
	
  /* TIM1 enable counter */
  TIM_Cmd(TIM1, ENABLE);
}

void usart_init()
{
  USART_InitStructure.USART_BaudRate = 115200;
  USART_InitStructure.USART_WordLength = USART_WordLength_8b;
  USART_InitStructure.USART_StopBits = USART_StopBits_1;
  USART_InitStructure.USART_Parity = USART_Parity_No;
  USART_InitStructure.USART_HardwareFlowControl = USART_HardwareFlowControl_None;
  USART_InitStructure.USART_Mode = USART_Mode_Rx | USART_Mode_Tx;
  
  USART_Init(USART1, &USART_InitStructure);
  USART_Init(USART2, &USART_InitStructure);
	
	USART_Cmd(USART1, ENABLE);
	USART_Cmd(USART2, ENABLE);
}

void spi_init()
{
	SPI_InitTypeDef   SPI_InitStructure;

  SPI_InitStructure.SPI_Direction = SPI_Direction_2Lines_FullDuplex;
  SPI_InitStructure.SPI_Mode = SPI_Mode_Master;
  SPI_InitStructure.SPI_DataSize = SPI_DataSize_8b;
  SPI_InitStructure.SPI_CPOL = SPI_CPOL_Low;
  SPI_InitStructure.SPI_CPHA = SPI_CPHA_1Edge;
  SPI_InitStructure.SPI_NSS = SPI_NSS_Soft;
  SPI_InitStructure.SPI_BaudRatePrescaler = SPI_BaudRatePrescaler_64;
  SPI_InitStructure.SPI_FirstBit = SPI_FirstBit_MSB;
  SPI_InitStructure.SPI_CRCPolynomial = 7;
  SPI_Init(SPI1, &SPI_InitStructure);
	
	SPI_Cmd(SPI1, ENABLE);
}

void spi_send(uint8_t dat)
{
  SPI_I2S_SendData(SPI1, dat);
  while(SPI_I2S_GetFlagStatus(SPI1, SPI_I2S_FLAG_TXE) == RESET);
}

void WriteLCM(uint8_t dat)
{
	uint32_t i;
	GPIO_WriteBit(GPIOC, GPIO_Pin_15, Bit_RESET);	//	LCMCS=0;
	spi_send(dat);
	for(i=0;i<200;i++);
	GPIO_WriteBit(GPIOC, GPIO_Pin_15, Bit_SET);	//	LCMCS=1;
}

//向指定行列处写汉字
void LCM_PUTHZ(const uint8_t *hz, uint8_t page, uint8_t col)//hz是汉字数据的首地址
{
	unsigned char i;
	
	GPIO_WriteBit(GPIOB, GPIO_Pin_12, Bit_RESET);	//	LCMDI=0;
 
	WriteLCM(0xB0|page);   //Set Page 0-7
	
	WriteLCM(0x10|(col>>4));     //Set Col H
	WriteLCM(0x00|(col&0xf));    //Set Col L
	
	GPIO_WriteBit(GPIOB, GPIO_Pin_12, Bit_SET);	//	LCMDI=1;
	
	for(i=0;i<16;i++)
		WriteLCM(*hz++);

	GPIO_WriteBit(GPIOB, GPIO_Pin_12, Bit_RESET);	//	LCMDI=0;
 
	WriteLCM(0xB0|((page+1)&0x7));   //Set Page 0-7
	
	WriteLCM(0x10|(col>>4));     //Set Col H
	WriteLCM(0x00|(col&0xf));    //Set Col L
	
	GPIO_WriteBit(GPIOB, GPIO_Pin_12, Bit_SET);	//	LCMDI=1;
	
	for(i=0;i<16;i++)
		WriteLCM(*hz++);
}

//向指定行列处写ASCII字符
void LCM_PUTCH(uint8_t asc, uint8_t page, uint8_t col)//str 是字符串数据的首地址
{
	unsigned char i;
	const uint8_t *ch = azk16[asc-' '];
	
	GPIO_WriteBit(GPIOB, GPIO_Pin_12, Bit_RESET);	//	LCMDI=0;
 
	WriteLCM(0xB0|page);   //Set Page 0-7
	
	WriteLCM(0x10|(col>>4));     //Set Col H
	WriteLCM(0x00|(col&0xf));    //Set Col L
	
	GPIO_WriteBit(GPIOB, GPIO_Pin_12, Bit_SET);	//	LCMDI=1;
	
	for(i=0;i<8;i++)
		WriteLCM(*ch++);

	GPIO_WriteBit(GPIOB, GPIO_Pin_12, Bit_RESET);	//	LCMDI=0;
 
	WriteLCM(0xB0|((page+1)&0x7));   //Set Page 0-7
	
	WriteLCM(0x10|(col>>4));     //Set Col H
	WriteLCM(0x00|(col&0xf));    //Set Col L
	
	GPIO_WriteBit(GPIOB, GPIO_Pin_12, Bit_SET);	//	LCMDI=1;
	
	for(i=0;i<8;i++)
		WriteLCM(*ch++);
}

void lcm_init()
{
	GPIO_WriteBit(GPIOB, GPIO_Pin_12, Bit_RESET);	//	LCMDI=0;

	WriteLCM(0xE2); //Reset

	WriteLCM(0x2F); //Power ON
	WriteLCM(0xAF); //LCD Panel ON

	WriteLCM(0x81); //Set ref voltage
	WriteLCM(0x20); //Ref voltage value = 26
						 
	WriteLCM(0xA2); //A2 A3 Bias set

	WriteLCM(0xA0); //Col direction Col1 -> Col128
	WriteLCM(0xC8); //Page direction Col7 -> Col0
	WriteLCM(0xA7); //A6=No Reverse Display A7=Reverse

	WriteLCM(0x60); //Initial Display Line
}

void LCM_PP(const unsigned char PicData[])
{
    unsigned char i,j;
    
    for(j=0;j<8;j++)
    {
			GPIO_WriteBit(GPIOB, GPIO_Pin_12, Bit_RESET);	//	LCMDI=0;
		 
			WriteLCM(0xB0|j);   //Set Page 0-7
			
			WriteLCM(0x10);     //Set Col 0
			WriteLCM(0x00);     //Set Col 1
			
			GPIO_WriteBit(GPIOB, GPIO_Pin_12, Bit_SET);	//	LCMDI=1;
			
			for(i=0;i<128;i++)
					WriteLCM(~PicData[i+128*j]);
    }
}

void usart_putchar(USART_TypeDef* USART, char ch)
{
	// 通过USART向外发送数据
  USART_SendData(USART, ch);
	// 等待发送缓冲区变成空的（就是发完了的意思）
	while(USART_GetFlagStatus(USART, USART_FLAG_TXE) == RESET){}
}

void usart_putstr(USART_TypeDef* USART, char *s)
{
	while(*s)
	{
		usart_putchar(USART, *s++);
	}
}

char usart_recv(USART_TypeDef* USART)
{
	// 接收缓冲区非空（就是收到了数据的意思）
	if(USART_GetFlagStatus(USART, USART_FLAG_RXNE) == SET)
	{
		return USART_ReceiveData(USART);
	}
	else
	{
		return 0;
	}
}

uint8_t ReadKey1()
{
	if(GPIO_ReadInputDataBit(GPIOA,GPIO_Pin_12) == Bit_RESET)
	{
		usart_putstr(USART1," > KEY1 PRESS\r\n");
		while(GPIO_ReadInputDataBit(GPIOA,GPIO_Pin_12) == Bit_RESET);
		usart_putstr(USART1,"   ==> KEY1 RELEASE\r\n");
		return 1;
	}
	return 0;
}

uint8_t ReadKey2()
{
	if(GPIO_ReadInputDataBit(GPIOA,GPIO_Pin_11) == Bit_RESET)
	{
		usart_putstr(USART1," > KEY2 PRESS\r\n");
		while(GPIO_ReadInputDataBit(GPIOA,GPIO_Pin_11) == Bit_RESET);
		usart_putstr(USART1,"   ==> KEY2 RELEASE\r\n");
		return 1;
	}
	return 0;
}

int main(void)
{
	clock_init();
	
	pin_remap_init();

	gpio_init();
	
	timer_init();
	
	//audio_init();
	
	usart_init();
	
	spi_init();
	
	SysTick_Config(SystemCoreClock / 1000);	// 中断频率1000Hz
	
	usart_putstr(USART1,"Hello world !\r\n");
	
	disp[0]=0x00ff0000;
	disp[1]=fonts[3];
	disp[2]=0x00bf0040;
	disp[3]=fonts[1];

	lcm_init();
	
	//LCM_PP(bmp);
	
	LCM_PUTCH(' ',0,8*0);
	LCM_PUTCH('!',0,8*1);
	LCM_PUTCH(' ',0,8*2);
	LCM_PUTCH('I',0,8*3);
	LCM_PUTCH(' ',0,8*4);
	LCM_PUTCH('L',0,8*5);
	LCM_PUTCH('o',0,8*6);
	LCM_PUTCH('v',0,8*7);
	LCM_PUTCH('e',0,8*8);
	LCM_PUTCH(' ',0,8*9);
	LCM_PUTCH('H',0,8*10);
	LCM_PUTCH('I',0,8*11);
	LCM_PUTCH('T',0,8*12);
	LCM_PUTCH(' ',0,8*13);
	LCM_PUTCH('!',0,8*14);
	LCM_PUTCH(' ',0,8*15);

	while(1)
	{
		;
	}

}
